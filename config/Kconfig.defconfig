## config/Kconfig.defconfig
```kconfig
# Copyright (c) 2021 The ZMK Contributors
# SPDX-License-Identifier: MIT
if SHIELD_Glove80_lh

config ZMK_KEYBOARD_NAME
    default "Glove80"

config ZMK_SPLIT_ROLE_CENTRAL
    default y

endif

if SHIELD_Glove80_lh || SHIELD_Glove80_rh

config ZMK_SPLIT
    default y

endif


if USB

config USB_NRFX
    default y

config USB_DEVICE_STACK
    default y

endif # USB
```

## config/Kconfig.shield
```kconfig
# Copyright (c) 2021 The ZMK Contributors
# SPDX-License-Identifier: MIT
config SHIELD_Glove_lh
    def_bool $(shields_list_contains,glove80_lh)

config SHIELD_Glove_rh
    def_bool $(shields_list_contains,glove80_rh)
```
